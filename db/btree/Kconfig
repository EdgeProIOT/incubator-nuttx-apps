## db/btree/Kconfig
```kconfig
#
# For a description of the syntax of this configuration file,
# see the file kconfig-language.txt in the NuttX tools repository.
#

config DB_BTREE
	bool "BTree library"
	default n
	---help---
		Enable the BTree library

if DB_BTREE

endif
```

## edgepro/lvglterm/Kconfig
```kconfig
#
# For a description of the syntax of this configuration file,
# see the file kconfig-language.txt in the NuttX tools repository.
#

menuconfig EDGEPRO_LVGLTERM
	tristate "LVGL Terminal"
	default n
	depends on GRAPHICS_LVGL
	---help---
		Enable LVGL Terminal

if EDGEPRO_LVGLTERM

config EDGEPRO_LVGLTERM_PRIORITY
	int "lvglterm task priority"
	default 100

config EDGEPRO_LVGLTERM_STACKSIZE
	int "lvglterm stack size"
	default 16384

endif # EDEGPRO_LVGLTERM
```

## examples/nina/Kconfig
```kconfig
#
# For a description of the syntax of this configuration file,
# see the file kconfig-language.txt in the NuttX tools repository.
#

config EXAMPLES_NINA
	tristate "NINA Boot program"
	default n
	---help---
		Enable the NINA Boot program

if EXAMPLES_NINA

config EXAMPLES_NINA_STACKSIZE
	int "NINA stack size"
	default DEFAULT_TASK_STACKSIZE

config EXAMPLES_NINA_PRIORITY
	int "NINA task priority"
	default 50

config EXAMPLES_NINA_BUFSIZE
	int "Buffer size"
	default 4096
	---help---
		Specifies the default buffer size

config EXAMPLES_NINA_CONSOLE_DEVPATH
	string "Console serial device path"
	default "/dev/ttyACM0"
	---help---
		The default path for the console serial device

config EXAMPLES_NINA_MODULE_DEVPATH
	string "Module serial device path"
	default "/dev/ttyS1"
	---help---
		The default path for the module serial device

endif
```

## examples/ninaboot/Kconfig
```kconfig
#
# For a description of the syntax of this configuration file,
# see the file kconfig-language.txt in the NuttX tools repository.
#

config EXAMPLES_NINABOOT
	tristate "NINA Boot serial port bridge"
	default n
	---help---
		Enable the NINA Boot serial port bridge

if EXAMPLES_NINABOOT

config EXAMPLES_NINABOOT_STACKSIZE
	int "NINA Boot stack size"
	default DEFAULT_TASK_STACKSIZE

config EXAMPLES_NINABOOT_PRIORITY
	int "NINA Boot task priority"
	default 50

config EXAMPLES_NINABOOT_BUFSIZE
	int "Buffer size"
	default 11520
	---help---
		Specifies the default buffer size

config EXAMPLES_NINABOOT_DEVPATH_IN
	string "Serial device in path"
	default "/dev/ttyACM0"
	---help---
		The default path to the serial in device

config EXAMPLES_NINABOOT_DEVPATH_OUT
	string "Serial device out path"
	default "/dev/ttyS1"
	---help---
		The default path to the serial out device

endif
```

## interpreters/luajit/Kconfig
```kconfig
#
# For a description of the syntax of this configuration file,
# see the file kconfig-language.txt in the NuttX tools repository.
#

config INTERPRETERS_LUAJIT
	tristate "LuaJIT"
	default n

if INTERPRETERS_LUAJIT

config LUAJIT_VERSION
	string "LuaJIT version"
	default "505e2c03de35e2718eef0d2d3660712e06dadf1f"

config INTERPRETERS_LUAJIT_PRIORITY
	int "LuaJIT REPL priority"
	default 100

config INTERPRETERS_LUAJIT_STACKSIZE
	int "LuaJIT REPL stack size"
	default 16384

config LUAJIT_ALLOC_START
	hex "Alloc start"
	default 0x20200000

config LUAJIT_ALLOC_SIZE
	hex "Alloc size"
	default 0xA0000

config LUAJIT_MCODE_START
	hex "MCode start"
	default 0x00000000

config LUAJIT_MCODE_SIZE
	hex "MCode size"
	default 0x20000

endif
```

## netutils/nng/Kconfig
```kconfig
#
# For a description of the syntax of this configuration file,
# see the file kconfig-language.txt in the NuttX tools repository.
#

config NETUTILS_NNG
	tristate "Enable Nanomsg NG"
	default n
	---help---
		Enable NNG

if NETUTILS_NNG

config NETUTILS_NNG_VERSION
	string "NNG Version"
	default "1.5.2"

endif
```
